## Kconfig
```kconfig
# Personal Elora lighting module.

DT_CHOSEN_ZMK_UNDERGLOW := zmk,underglow

config ELORA_LIGHTING
    bool "Layer lighting"
    depends on $(dt_chosen_enabled,$(DT_CHOSEN_ZMK_UNDERGLOW))
    depends on !ZMK_RGB_UNDERGLOW && !ZMK_EXT_POWER
    select LED_STRIP
    select GPIO
    help
        Shows the highest active layer on the underglow pixels and, while
        per-key colors are on, role colors on the key pixels. The central owns the lighting state and sends it to
        the peripheral as one snapshot. Replaces the stock RGB renderer and
        drives the LED supply pin directly, without the ext-power driver.

if ELORA_LIGHTING

config ELORA_LIGHTING_IDLE_TIMEOUT_MS
    int "Milliseconds without key or layer activity before the lights go dark"
    default 30000

config ELORA_LIGHTING_BRT_MIN
    int "Lowest brightness in percent"
    range 1 100
    default 5

config ELORA_LIGHTING_BRT_MAX
    int "Highest brightness in percent"
    range 1 100
    default 25

config ELORA_LIGHTING_BRT_STEP
    int "Brightness step in percentage points"
    range 1 100
    default 5

config ELORA_LIGHTING_BRT_START
    int "Brightness in percent until a stored value exists"
    range 1 100
    default 10

endif

config ELORA_LIGHTING_MAP_DIAG
    bool "LED chain mapping diagnostic"
    depends on $(dt_chosen_enabled,$(DT_CHOSEN_ZMK_UNDERGLOW))
    depends on !ZMK_RGB_UNDERGLOW && !ZMK_EXT_POWER && !ELORA_LIGHTING
    select LED_STRIP
    select GPIO
    help
        Lights one pixel of the zmk,underglow chain at a time and logs the
        key the user presses for it. Every key press is consumed, so an
        image with this option is only for a mapping session. The LED
        supply pin is driven directly, without the ext-power driver and its
        saved settings.

if ELORA_LIGHTING_MAP_DIAG

config ELORA_LIGHTING_MAP_DIAG_LEVEL
    int "Per-channel level of the lit pixel"
    range 1 255
    default 32

endif
```

## dts/bindings/behaviors/elora,behavior-lighting-sync.yaml
```yaml
# SPDX-License-Identifier: MIT

description: Elora lighting snapshot transfer from the central to a peripheral

compatible: "elora,behavior-lighting-sync"

include: two_param.yaml
```

## dts/bindings/behaviors/elora,behavior-lighting.yaml
```yaml
# SPDX-License-Identifier: MIT

description: Elora lighting controls (LIT_ON, LIT_OFF, LIT_BRI, LIT_BRD, LIT_KEYS_ON,
  LIT_KEYS_OFF)

compatible: "elora,behavior-lighting"

include: one_param.yaml
```

## dts/bindings/elora,lighting.yaml
```yaml
# SPDX-License-Identifier: MIT

description: |
  Elora layer lighting data. Each child node gives a group of keys on one
  layer a shared color for its role.

compatible: "elora,lighting"

properties:
  layer-colors:
    type: array
    required: true
    description: |
      Underglow color per keymap layer ID as 0xRRGGBB at full scale. The
      brightness setting scales these values; 0 keeps the underglow dark.

  underglow-pixels:
    type: array
    description: |
      Indices of this half's underglow pixels in the zmk,underglow chain. Set
      per half in the config overlays; required when ELORA_LIGHTING is on.

  keys-replace-underglow:
    type: array
    description: |
      Layer IDs whose underglow stays dark while per-key colors are on,
      because their key colors already identify the layer.

  key-pixels:
    type: array
    description: |
      Pairs of pixel index and keymap position for this half's key pixels.
      Set per half in the config overlays; required when ELORA_LIGHTING is on.

child-binding:
  description: Keys on one layer that light in one role color
  properties:
    layer:
      type: int
      required: true
      description: Keymap layer ID
    color:
      type: int
      required: true
      description: |
        Role color as 0xRRGGBB at full scale, scaled by the brightness
        setting like the underglow.
    positions:
      type: array
      required: true
      description: Keymap positions of the keys on that layer
```
