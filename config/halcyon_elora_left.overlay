/*
 * Left half LED chain: pixels 0-5 are underglow, 6-36 sit under the keys.
 * Measured with the LED mapping diagnostic.
 */

/ {
  elora_lighting {
    underglow-pixels = <0 1 2 3 4 5>;
    /* Pixel and key position pairs, one key row per line. */
    key-pixels = <
       6 56   7 55   8 54   9 53  10 52
      11 43  12 42  13 41  14 40  15 39  16 38  17 37  18 36
      19 29  20 28  21 27  22 26  23 25  24 24
      25 17  26 16  27 15  28 14  29 13  30 12
      31  5  32  4  33  3  34  2  35  1  36  0
    >;
  };
};
