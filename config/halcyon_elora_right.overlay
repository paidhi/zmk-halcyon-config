/*
 * Right half LED chain: pixels 0-5 are underglow, 6-36 sit under the keys.
 * Measured with the LED mapping diagnostic.
 */

/ {
  elora_lighting {
    underglow-pixels = <0 1 2 3 4 5>;
    /* Pixel and key position pairs, one key row per line. */
    key-pixels = <
       6 57   7 58   8 59   9 60  10 61
      11 44  12 45  13 46  14 47  15 48  16 49  17 50  18 51
      19 30  20 31  21 32  22 33  23 34  24 35
      25 18  26 19  27 20  28 21  29 22  30 23
      31  6  32  7  33  8  34  9  35 10  36 11
    >;
  };
};
